// US-100 sensor
const int trigPin = 5;
const int echoPin = 18;
const int red_ledPin = 19;
const int blue_ledPin = 16;
const int green_ledPin = 17;
int target = 30;
int distSetting = 0;
const int buttonPin = 12;
int section = target+(target*0.75);

int errorLow = 50;
int oldDistReading;
int loopNum = 0;

//oled display
#include <Wire.h>
#include <Adafruit_GFX.h>
#include <Adafruit_SSD1306.h>

#define SCREEN_WIDTH 128
#define SCREEN_HEIGHT 64

// Declaration for an SSD1306 display connected to I2C (SDA, SCL pins)
Adafruit_SSD1306 display(SCREEN_WIDTH, SCREEN_HEIGHT, &Wire, -1);
 
#define SOUND_SPEED 0.034
#define DELAY_BETWEEN_READINGS 100
 
long pulseDuration;
float distance, diff;
float mid = target+(section);

//array that holds the norse iot startup logo
const unsigned char NorseIOTLogo [] PROGMEM = {
  0x00, 0x00, 0x00, 0x00, 0x00, 0x00, 0x00, 0x00, 0x00, 0x00, 0x00, 0x00, 0x00, 0x00, 0x00, 0x00, 
  0x00, 0x00, 0x00, 0x00, 0x00, 0x00, 0x00, 0x00, 0x00, 0x00, 0x00, 0x00, 0x00, 0x00, 0x00, 0x00, 
  0x00, 0x00, 0x00, 0x00, 0x00, 0x00, 0x00, 0x00, 0x00, 0x00, 0x00, 0x00, 0x00, 0x00, 0x00, 0x00, 
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  0x00, 0x00, 0x00, 0x00, 0x00, 0x00, 0x00, 0x00, 0x00, 0x00, 0x00, 0x00, 0x00, 0x00, 0x00, 0x00
};


void setup() {
  Serial.begin(115200);

  pinMode(red_ledPin, OUTPUT);
  pinMode(blue_ledPin, OUTPUT);
  pinMode(green_ledPin, OUTPUT);
  pinMode(trigPin, OUTPUT);
  pinMode(echoPin, INPUT);
  pinMode(buttonPin, INPUT);

  if(!display.begin(SSD1306_SWITCHCAPVCC, 0x3C)) { // Address 0x3D for 128x64
    Serial.println(F("SSD1306 allocation failed"));
    for(;;);
  }
  
  //startup logo
  display.clearDisplay();
  display.drawBitmap(0, 0, NorseIOTLogo, 128, 64, 1);
  display.display();
  delay(4000);

  //set text parameters
  display.clearDisplay();
  display.setTextSize(2);
  display.setTextColor(WHITE);
  display.setCursor(0, 10);
}

int changeDistSetting(){
  Serial.println("settings changed");
  delay(500);
  if(distSetting == 0){
    return 1;
  }
  else{
    return 0;
  }
}

float calculateDist(long duration){
  if(distSetting == 0){
    return duration * SOUND_SPEED / 2;
  }
  else{
    return duration * SOUND_SPEED / 2 / 2.54;
  }
}
 
void readSensor() {
  digitalWrite(trigPin, LOW);
  delayMicroseconds(2);
  digitalWrite(trigPin, HIGH);
  delayMicroseconds(10);
  digitalWrite(trigPin, LOW);
  pulseDuration = pulseIn(echoPin, HIGH);
  distance = calculateDist(pulseDuration);
}

void pulseLights(){
  analogWrite (red_ledPin, 0);
  analogWrite (blue_ledPin, 0);
  analogWrite (green_ledPin, 0);
  for (int val = 0; val < 255; val++) {
       analogWrite(red_ledPin, val);
       delay(5);
   }
   for (int j = 255; j > 0; j--) {
      analogWrite(red_ledPin, j);
      delay(5);
   }
}
 
void loop() {
  readSensor();
  if (loopNum != 0){
    if (abs(oldDistReading-distance) > 50){
      distance = oldDistReading;
    }
  }
  else{
    oldDistReading = distance;
    loopNum++;
  }

  long int startHoldButtonTime = millis();
  long int endHoldButtonTime = millis();
  if (digitalRead(buttonPin) == HIGH){
    analogWrite(red_ledPin, 0);
    analogWrite(blue_ledPin, 0);
    analogWrite(green_ledPin, 0);
    while (digitalRead(buttonPin) == HIGH){
      endHoldButtonTime = millis();
      if(endHoldButtonTime - startHoldButtonTime > 5000){
        analogWrite(red_ledPin, 0);
        delay(100);
        analogWrite(red_ledPin, 255);
        delay(100);
      }
    }
  
    if(endHoldButtonTime - startHoldButtonTime > 3000){
        target = distance;
        section = target+(target*0.75);
        analogWrite(red_ledPin, 0);
        analogWrite(green_ledPin, 255);
        delay(200);
        analogWrite(green_ledPin, 0);
        delay(100);
        Serial.print("new target distance set to ");
        Serial.println(distance);
      }
      else{
        distSetting = changeDistSetting();
        if(distSetting == 0){
          target = target*2.54;
          mid = mid*2.54;
          errorLow = errorLow*2.54;
        }
        else{
          target = target/2.54;
          mid = mid/2.54;
          errorLow = errorLow/2.54;
        }
      }
  }

  Serial.print("Sensor Distance: ");
  Serial.print(distance);
  display.clearDisplay();
  display.setCursor(0, 10);
  display.print(distance);
  if(distSetting == 0){
    Serial.println("cm");
    display.println("cm");
  }
  else{
    Serial.println("in");
    display.println("in");
  }
  display.display(); 
  if (distance <= target){
    analogWrite(red_ledPin, 255);
    analogWrite(blue_ledPin, 0);
    analogWrite(green_ledPin, 0);
    Serial.println("LED red");
  }
  else if (distance > target && distance <= mid){
    analogWrite(red_ledPin, 240);
    analogWrite(blue_ledPin, 15);
    analogWrite(green_ledPin, 40);
    Serial.println("LED 0range");
  }
  else if (distance > mid){
    analogWrite(red_ledPin, 150);
    analogWrite(blue_ledPin, 40);
    analogWrite(green_ledPin, 125);
    Serial.println("LED yellow");
  }

  oldDistReading = distance;
  delay(DELAY_BETWEEN_READINGS);
}
